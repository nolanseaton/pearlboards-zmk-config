## config/boards/arm/pearl/Kconfig.board
```kconfig
# Pearl board configuration

# Copyright (c) 2023 The ZMK Contributors
# SPDX-License-Identifier: MIT

config BOARD_PEARL
	bool "pearl"
	depends on SOC_NRF52840_QIAA

config BOARD_ENABLE_DCDC
	bool "Enable DCDC mode"
	select SOC_DCDC_NRF52X
	default y
	depends on BOARD_PEARL

config BOARD_PEARL_CHARGER
	bool "Enable battery charger"
	default y
	depends on BOARD_PEARL
```

## config/boards/arm/pearl/Kconfig.defconfig
```kconfig
# Pearl board configuration

# Copyright (c) 2023 The ZMK Contributors
# SPDX-License-Identifier: MIT

if BOARD_PEARL

config ZMK_KEYBOARD_NAME
	default "PEARL 40% BT"

if USB

config USB_NRFX
	default y

config USB_DEVICE_STACK
	default y

endif # USB

config BT_CTLR
	default BT

config ZMK_BLE
	default y

config ZMK_USB
	default y

config BOARD_PEARL_CHARGER
	default y

config ZMK_BATTERY_VOLTAGE_DIVIDER
	default y

endif # BOARD_PEARL
```

## config/boards/arm/zeus/Kconfig.board
```kconfig
# Zeus board configuration

# Copyright (c) 2023 The ZMK Contributors
# SPDX-License-Identifier: MIT

config BOARD_ZEUS
	bool "zeus"
	depends on SOC_NRF52840_QIAA

config BOARD_ENABLE_DCDC
	bool "Enable DCDC mode"
	select SOC_DCDC_NRF52X
	default y
	depends on BOARD_ZEUS

config BOARD_ZEUS_CHARGER
	bool "Enable battery charger"
	default y
	depends on BOARD_ZEUS
```

## config/boards/arm/zeuspad/Kconfig.board
```kconfig
# Zeuspad board configuration

# Copyright (c) 2023 The ZMK Contributors
# SPDX-License-Identifier: MIT

# ZEUSPAD board configuration

config BOARD_ZEUSPAD
	bool "zeuspad"
	depends on SOC_NRF52840_QIAA

config BOARD_ENABLE_DCDC
	bool "Enable DCDC mode"
	select SOC_DCDC_NRF52X
	default y
	depends on BOARD_ZEUSPAD

config BOARD_ZEUSPAD_CHARGER
	bool "Enable battery charger"
	default y
	depends on BOARD_ZEUSPAD
```

## config/boards/arm/zeuspad/zeuspad_defconfig
```kconfig
# SPDX-License-Identifier: MIT

CONFIG_SOC_SERIES_NRF52X=y
CONFIG_SOC_NRF52840_QIAA=y

CONFIG_BUILD_OUTPUT_UF2=y

# Enable MPU
CONFIG_ARM_MPU=y

# Enable GPIO
CONFIG_GPIO=y

CONFIG_USE_DT_CODE_PARTITION=y

CONFIG_MPU_ALLOW_FLASH_WRITE=y
CONFIG_NVS=y
CONFIG_SETTINGS_NVS=y
CONFIG_FLASH=y
CONFIG_FLASH_PAGE_LAYOUT=y
CONFIG_FLASH_MAP=y
CONFIG_CLOCK_CONTROL_NRF_K32SRC_RC=y

# Enable encoder
CONFIG_EC11=y
CONFIG_EC11_TRIGGER_GLOBAL_THREAD=y

CONFIG_ZMK_USB_LOGGING=n
CONFIG_SENSOR_LOG_LEVEL_DBG=n
CONFIG_I2C_LOG_LEVEL_DBG=n

# Enable underglow
CONFIG_ZMK_RGB_UNDERGLOW=y
CONFIG_WS2812_STRIP=y
CONFIG_ZMK_RGB_UNDERGLOW_ON_START=y

# Enable more power
CONFIG_BT_CTLR_TX_PWR_PLUS_8=y

# Enable deep sleep. Timeout is in ms, 900000 is 15 minutes.
# Battery level is shown after waking from deep sleep.
CONFIG_ZMK_SLEEP=n
CONFIG_ZMK_IDLE_SLEEP_TIMEOUT=900000

# OLED config
CONFIG_ZMK_DISPLAY=y
CONFIG_I2C=y
CONFIG_I2C_NRFX=y
CONFIG_SSD1306=y
CONFIG_SSD1306_REVERSE_MODE=n
# CONFIG_LVGL_HOR_RES_MAX=128
# CONFIG_LVGL_VDB_SIZE=64
# CONFIG_LVGL_DPI=148
# CONFIG_LVGL_BITS_PER_PIXEL=1
# CONFIG_LVGL_COLOR_DEPTH_1=y
CONFIG_ZMK_WIDGET_LAYER_STATUS=y
CONFIG_ZMK_WIDGET_BATTERY_STATUS=y
CONFIG_ZMK_WIDGET_OUTPUT_STATUS=y
```
